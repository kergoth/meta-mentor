## meta-mel/conf/distro/mel-selftest.conf
```bitbake
require conf/distro/include/mel.conf

DISTRO .= "-selftest"
DISTRO_NAME += "Selftest"
DISTROOVERRIDES = "${DISTRO}:mel"

PREFERRED_PROVIDER_virtual/kernel_mel-selftest = "linux-dummy"

# Remove configuration items incompatible with oe-selftest
INHERIT_remove = "buildhistory"
PRSERV_HOST = ""

# Selftest demands that this not even exist in the metadata, so setting to the
# empty string is insufficient
require conf/distro/include/no_sanity_distros.inc
```
